## conf/layer.conf
```bitbake
# We have a conf and classes directory, add to BBPATH
BBPATH .= ":${LAYERDIR}"

# We have recipes-* directories, add to BBFILES
BBFILES += "${LAYERDIR}/recipes-*/*/*.bb \
            ${LAYERDIR}/recipes-*/*/*.bbappend"

BBFILE_COLLECTIONS += "qurlew"
BBFILE_PATTERN_qurlew = "^${LAYERDIR}/"
BBFILE_PRIORITY_qurlew = "8"
LAYERVERSION_qurlew = "1"
LAYERDEPENDS_qurlew += "qt5-layer"
```
